//#include <REG52.H>       

////单片机 AT89C52，晶振 11.0592 MHz

//// 定义蜂鸣器端口
//sbit GPIO_Beep = P3^0; 

//// 节拍计数器（中断会修改，因此必须 volatile）
//volatile unsigned char g_beat = 0;   

//volatile unsigned char g_songSelect = 0;  // 0 表示歌曲1，1 表示歌曲2

////------------------------------------------------------
//// 音符表：格式为 [tone, beat] 成对存储
//// 特殊符号：0xFF = 休止符；0x00 = 乐曲结束

//unsigned char code music_tab[] = {   
//    0x18, 0x30, 0x1C, 0x10,   
//    0x20, 0x40, 0x1C, 0x10,   
//    0x18, 0x10, 0x20, 0x10,   
//    0x1C, 0x10, 0x18, 0x40,   
//    0x1C, 0x20, 0x20, 0x20,   
//    0x1C, 0x20, 0x18, 0x20,   
//    0x20, 0x80, 0xFF, 0x20,   
//    0x30, 0x1C, 0x10, 0x18,   
//    0x20, 0x15, 0x20, 0x1C,   
//    0x20, 0x20, 0x20, 0x26,   
//    0x40, 0x20, 0x20, 0x2B,   
//    0x20, 0x26, 0x20, 0x20,   
//    0x20, 0x30, 0x80, 0xFF,   
//    0x20, 0x20, 0x1C, 0x10,   
//    0x18, 0x10, 0x20, 0x20,   
//    0x26, 0x20, 0x2B, 0x20,   
//    0x30, 0x20, 0x2B, 0x40,   
//    0x20, 0x20, 0x1C, 0x10,   
//    0x18, 0x10, 0x20, 0x20,   
//    0x26, 0x20, 0x2B, 0x20,   
//    0x30, 0x20, 0x2B, 0x40,   
//    0x20, 0x30, 0x1C, 0x10,   
//    0x18, 0x20, 0x15, 0x20,   
//    0x1C, 0x20, 0x20, 0x20,   
//    0x26, 0x40, 0x20, 0x20,   
//    0x2B, 0x20, 0x26, 0x20,   
//    0x20, 0x20, 0x30, 0x80,   
//    0x20, 0x30, 0x1C, 0x10,   
//    0x20, 0x10, 0x1C, 0x10,   
//    0x20, 0x20, 0x26, 0x20,   
//    0x2B, 0x20, 0x30, 0x20,   
//    0x2B, 0x40, 0x20, 0x15,   
//    0x1F, 0x05, 0x20, 0x10,   
//    0x1C, 0x10, 0x20, 0x20,   
//    0x26, 0x20, 0x2B, 0x20,   
//    0x30, 0x20, 0x2B, 0x40,   
//    0x20, 0x30, 0x1C, 0x10,   
//    0x18, 0x20, 0x15, 0x20,   
//    0x1C, 0x20, 0x20, 0x20,   
//    0x26, 0x40, 0x20, 0x20,   
//    0x2B, 0x20, 0x26, 0x20,   
//    0x20, 0x20, 0x30, 0x30,   
//    0x20, 0x30, 0x1C, 0x10,   
//    0x18, 0x40, 0x1C, 0x20,   
//    0x20, 0x20, 0x26, 0x40,   
//    0x13, 0x60, 0x18, 0x20,   
//    0x15, 0x40, 0x13, 0x40,   
//    0x18, 0x80, 0x00           // 0x00 表示结束
//};   
//// --- 歌曲 2: 小星星 ---
////unsigned char code music2_tab[] = {
////    0x18, 0x10, 0x18, 0x10, 0x10, 0x10, 0x10, 0x10, 0x0E, 0x10, 0x0E, 0x10, 0x10, 0x20,
////    0x12, 0x10, 0x12, 0x10, 0x14, 0x10, 0x14, 0x10, 0x16, 0x10, 0x16, 0x10, 0x18, 0x20,
////    0x10, 0x10, 0x10, 0x10, 0x12, 0x10, 0x12, 0x10, 0x14, 0x10, 0x14, 0x10, 0x16, 0x20,
////    0x10, 0x10, 0x10, 0x10, 0x12, 0x10, 0x12, 0x10, 0x14, 0x10, 0x14, 0x10, 0x16, 0x20,
////    0x18, 0x10, 0x18, 0x10, 0x10, 0x10, 0x10, 0x10, 0x0E, 0x10, 0x0E, 0x10, 0x10, 0x20,
////    0x12, 0x10, 0x12, 0x10, 0x14, 0x10, 0x14, 0x10, 0x16, 0x10, 0x16, 0x10, 0x18, 0x20,
////    0x00 // 歌曲结束标志
////};

//unsigned char code music2_tab[] = {
//    // 5 3 5, 5 3 5
//    0x10, 0x08, 0x14, 0x08, 0x10, 0x10, 0x10, 0x08, 0x14, 0x08, 0x10, 0x10, 
//    // 5 6 5 4 | 3 1 -
//    0x10, 0x08, 0x0E, 0x08, 0x10, 0x08, 0x12, 0x08, 0x14, 0x10, 0x18, 0x20, 
//    // 5 3 5, 5 3 5
//    0x10, 0x08, 0x14, 0x08, 0x10, 0x10, 0x10, 0x08, 0x14, 0x08, 0x10, 0x10, 
//    // 5 6 5 4 | 3 2 -
//    0x10, 0x08, 0x0E, 0x08, 0x10, 0x08, 0x12, 0x08, 0x14, 0x10, 0x16, 0x20,
//    0xFF, 0x10,
//    0x00 
//};

//// Timer0 中断函数：每隔约 10.85ms 触发一次
//// 功能：递减节拍计数 g_beat

//void Timer0_ISR() interrupt 1   
//{
//    TH0 = 0xD8;   // 重装初值高字节
//    TL0 = 0xEF;   // 重装初值低字节
//    g_beat--;     // 节拍计数减一
//}


//void ExtInt1_ISR() interrupt 2
//{
//    g_songSelect ^= 1;   // 在 0 和 1 之间切换
//}


//// 音符频率延时：控制方波的半周期长度
//// tone 越大 -> 延时越长 -> 频率越低

//void AudioFrequencyDelay (unsigned char m)    
//{   
//    unsigned int i = 3 * m;   
//    while(--i);   // 空循环延时
//} 


//// 发一个音符：tone=音高，beat=节拍长度

//void BeepTone(unsigned char tone, unsigned char beat)   
//{
//    g_beat = beat;   // 设置节拍数
//    TR0 = 1;         // 打开 Timer0
//    while(g_beat != 0)   // 节拍未耗尽则继续输出方波
//    {
//        GPIO_Beep = !GPIO_Beep;   // 翻转蜂鸣器输出
//        AudioFrequencyDelay(tone);
//    }
//    TR0 = 0;         // 关闭 Timer0
//}


//void Delay10ms(unsigned int c)   
//{
//    unsigned char a, b;
//    for (; c > 0; c--)
//    {
//        for (b = 38; b > 0; b--)
//        {
//            for (a = 130; a > 0; a--);
//        }
//    }       
//}

//// Timer0 初始化：16位模式，每次溢出约 10.85ms
//void InitTimer0()
//{
//    TMOD = 0x01;      // 选择 Timer0 16位模式
//    TH0 = 0xD8;       // 初值高字节
//    TL0 = 0xEF;       // 初值低字节
//    IE  = 0x82;       // EA=1, ET0=1，允许 Timer0 中断
//}
////外部中断
//void InitExtInt1()
//{
//    IT1 = 1;   // 下降沿触发
//    EX1 = 1;   // 允许外部中断0
//    EA  = 1;   // 总中断允许
//		IP = 0x01;   // PX0=1，其余=0

//}
//void PlaySong(unsigned char code *song)
//{
//    unsigned char i = 0;
//    unsigned char tmpTone = 0;

//    while(1)
//    {
//        // 播放过程中检测切歌
//        if((g_songSelect == 0 && song != music_tab) ||
//           (g_songSelect == 1 && song != music2_tab))
//        {
//            return;  // 立即退出，去播放另一首
//        }

//        tmpTone = song[i]; 
//        if(tmpTone == 0x00)      // 结束符
//        {
//            return; 
//        }       
//        else if(tmpTone == 0xFF) // 休止符
//        { 
//            ++i;                  
//            Delay10ms(10);        
//            TR0 = 0;              
//            continue;
//        }      
//        else 
//        {
//            unsigned char tone, beat;
//            tone = song[i++];   
//            beat = song[i++];   
//            BeepTone(tone, beat);    
//        }
//    }   
//}




//void main()   
//{
//		InitExtInt1();   
//    InitTimer0();    // 初始化定时器
//    while(1)   
//    {
//			if(g_songSelect == 0)
//        {
//            PlaySong(music_tab);     
//        }
//        else
//        {
//            PlaySong(music2_tab);
//        }
//        Delay10ms(300);      // 歌曲间隔约 3 秒
//    }   
//}

#include <REG52.H>
#include <INTRINS.H>

// 本例采用89C52, 晶振为11.0592MHZ
sbit GPIO_Beep = P3^0; // 蜂鸣器/扬声器引脚
sbit GPIO_Key  = P1^0; // 歌曲切换按键引脚

unsigned char g_beat = 0;           // 全局节拍计数变量
unsigned char g_song_index = 0;     // 全局歌曲索引，用于在任何地方切换歌曲
bit g_key_pressed_flag = 0;     // 按键中断标志，用于通知播放函数退出

// --- 歌曲 1: 八月桂花遍地开 (您的原始数据) ---
unsigned char code song1_tab[] = {
    0x18, 0x30, 0x1C , 0x10, 0x20, 0x40, 0x1C , 0x10, 0x18, 0x10, 0x20 , 0x10,
    0x1C, 0x10, 0x18 , 0x40, 0x1C, 0x20, 0x20 , 0x20, 0x1C, 0x20, 0x18 , 0x20,
    0x20, 0x80, 0xFF , 0x20, 0x30, 0x1C, 0x10 , 0x18, 0x20, 0x15, 0x20 , 0x1C,
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    0x13, 0x60, 0x18 , 0x20, 0x15, 0x40, 0x13 , 0x40, 0x18, 0x80,
    0x00 // 歌曲结束标志
};

// --- 歌曲 2: 小星星 ---
unsigned char code song2_tab[] = {
    0x18, 0x10, 0x18, 0x10, 0x10, 0x10, 0x10, 0x10, 0x0E, 0x10, 0x0E, 0x10, 0x10, 0x20,
    0x12, 0x10, 0x12, 0x10, 0x14, 0x10, 0x14, 0x10, 0x16, 0x10, 0x16, 0x10, 0x18, 0x20,
    0x10, 0x10, 0x10, 0x10, 0x12, 0x10, 0x12, 0x10, 0x14, 0x10, 0x14, 0x10, 0x16, 0x20,
    0x10, 0x10, 0x10, 0x10, 0x12, 0x10, 0x12, 0x10, 0x14, 0x10, 0x14, 0x10, 0x16, 0x20,
    0x18, 0x10, 0x18, 0x10, 0x10, 0x10, 0x10, 0x10, 0x0E, 0x10, 0x0E, 0x10, 0x10, 0x20,
    0x12, 0x10, 0x12, 0x10, 0x14, 0x10, 0x14, 0x10, 0x16, 0x10, 0x16, 0x10, 0x18, 0x20,
    0x00 // 歌曲结束标志
};

// --- 歌曲 3: 两只老虎 ---
unsigned char code song3_tab[] = {
    0x16, 0x10, 0x14, 0x10, 0x12, 0x10, 0x16, 0x10, // 1 2 3 1
    0x16, 0x10, 0x14, 0x10, 0x12, 0x10, 0x16, 0x10, // 1 2 3 1
    0x12, 0x10, 0x10, 0x10, 0x0E, 0x20,             // 3 4 5
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    0x10, 0x10, 0x20, 0x10, 0x18, 0x20,             // 5 低5 1
    0x00 // 歌曲结束标志
};

#define SONG_COUNT 3 // 定义歌曲的总数
// 创建一个指针数组，用于存放所有歌曲的地址
unsigned char code *song_list[SONG_COUNT] = { song1_tab, song2_tab, song3_tab };

// 毫秒级延时函数
void DelayMs(unsigned int c)
{
    unsigned char a, b;
    for (;c>0;c--)
        for (b=19;b>0;b--)
            for (a=130;a>0;a--);
}

// 定时器0中断服务程序，用于控制节拍
void int0() interrupt 1
{
    TH0 = 0xd8; // 重新装载10ms定时初值
    TL0 = 0xef;
    g_beat--;
}

// 控制音调(频率)的延时
void AudioFrequencyDelay (unsigned char m)
{
    unsigned i=3*m;
    while(--i);
}

// [修改点 1] 在最耗时的函数中加入按键检测
// 播放一个音符，如果在播放期间检测到按键，则立刻停止并返回
void BeepTone(unsigned char tone, unsigned char beat)
{
    g_beat = beat;
    TR0 = 1; // 开启定时器0，开始计算节拍
    while(g_beat != 0 && !g_key_pressed_flag) // 在节拍未结束且未检测到按键时循环
    {
        GPIO_Beep = ~GPIO_Beep;
        AudioFrequencyDelay(tone);

        // 在产生音频的循环中检测按键，确保最高响应性
        if (GPIO_Key == 0)
        {
            DelayMs(20); // 按键消抖
            if (GPIO_Key == 0) // 确认按键按下
            {
                g_key_pressed_flag = 1; // 设置按键标志
                while(!GPIO_Key); // 等待按键释放
            }
        }
    }
    TR0 = 0; // 关闭定时器0
}

// [修改点 2] 播放歌曲函数也要能被中断
void PlaySong(unsigned char code *music_tab)
{
    unsigned int i = 0;
    unsigned char tmpTone = 0;

    g_key_pressed_flag = 0; // 开始播放前，清除按键标志

    while(!g_key_pressed_flag) // 循环条件：按键未被按下
    {
        // 每次循环开始时都检查按键，确保在音符之间也能快速响应
        if (GPIO_Key == 0)
        {
            DelayMs(20);
            if (GPIO_Key == 0)
            {
                g_key_pressed_flag = 1;
                while(!GPIO_Key);
                continue; // 跳出本次循环，外层while会判断标志并退出
            }
        }

        tmpTone = music_tab[i];
        if(tmpTone == 0x00) // 如果碰到结束符
        {
            return; // 正常结束播放
        }
        else if(tmpTone == 0xff) // 若碰到休止符
        {
            i++;
            TR0 = 0;
            DelayMs(100); // 休止符延时
            continue;
        }
        else
        {
            unsigned char tone, beat;
            tone = music_tab[i++];
            beat = music_tab[i++];
            BeepTone(tone, beat); // 调用修改后的BeepTone
        }
    }
}


// 初始化定时器0
void InitTimer0()
{
    TMOD = 0x01; // 选择16位计数器
    TH0 = 0xd8;  // (65535 - 10000) / 256
    TL0 = 0xef;  // (65535 - 10000) % 256
    IE = 0x82;   // 允许定时器T0中断和总中断
}

// [修改点 3] 主函数逻辑简化
void main()
{
    InitTimer0();

    while(1)
    {
        // 播放当前索引指向的歌曲
        // PlaySong函数现在会在检测到按键时自行退出
        PlaySong(song_list[g_song_index]);

        // 从PlaySong退出后，无论是正常结束还是被中断，都检查按键标志
        if (g_key_pressed_flag)
        {
            // 如果是因按键而中断，则切换到下一首歌
            g_song_index++;
            if (g_song_index >= SONG_COUNT)
            {
                g_song_index = 0; // 循环播放
            }
        }
        // 如果是正常播放结束，代码会继续执行到这里。
        // 由于没有按键按下，g_song_index 不会改变，
        // 下一次循环会重新播放同一首歌。
        // 如果你希望正常结束后自动播放下一首，
        // 可以将上面的 if 判断逻辑改为无条件执行 g_song_index++。
    }
}